## config/boards/shields/my_keyboard/Kconfig.defconfig
```kconfig
if SHIELD_TOTEM_LEFT
config ZMK_KEYBOARD_NAME
    default "TOTEM"
endif

if SHIELD_TOTEM_RIGHT
config ZMK_KEYBOARD_NAME
    default "TOTEM"
endif

if SHIELD_MY_KEYBOARD_DONGLE
config ZMK_KEYBOARD_NAME
    default "TOTEM"
config ZMK_SPLIT_ROLE_CENTRAL
    default y
config ZMK_USB
    default y
endif
```
